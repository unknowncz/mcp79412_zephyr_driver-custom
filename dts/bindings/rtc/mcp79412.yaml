## dts/bindings/rtc/mcp79412.yaml
```yaml
compatible: "microchip,mcp79412"

include: [base.yaml, i2c-device.yaml, rtc-device.yaml]

description: |
  mcp79412 RTC calendar

properties:
  vbat-enable:
    type: boolean
    required: false
    description: Enable Vbat.
  irq-gpios:
    type: phandle-array
    description: |
      The INT1 signal connection.
```

## drivers/rtc/Kconfig
```kconfig
menuconfig MCP79412
	bool "MCP79412 RTC IC"
	default y
	depends on DT_HAS_MICROCHIP_MCP79412_ENABLED

if MCP79412

endif
```

## dts/bindings/rtc/mcp79412.yaml
```yaml
compatible: "microchip,mcp79412"

include: [base.yaml, i2c-device.yaml, rtc-device.yaml]

description: |
  mcp79412 RTC calendar

properties:
  vbat-enable:
    type: boolean
    required: false
    description: Enable Vbat.
  int-gpios:
    type: phandle-array
    description: |
      The INT1 signal connection.
```
